{
0,0,0,0,0,0,0,0,0,0,0,0,0,0,0,0,0,0,0,0,0,0,0,0,0,0,0,0,0,0,0,0,0,0,0,0,0,0,0,0,0,0,0,0,0,64,40,3,0,0,0,0,0,0,0,0,0,0,0,0,0,0,0,0
},

{
0,0,0,0,0,0,0,112,240,240,70,0,0,0,0,0,0,0,0,0,0,0,0,0,0,0,0,0,0,0,0,0,0,0,0,0,0,0,0,0,0,0,0,0,1,241,255,220,0,0,0,0,0,0,0,0,0,0,0,0,0,0,0,0
},

{
0,0,0,0,0,0,0,103,255,255,82,0,0,0,0,0,0,0,0,0,0,0,0,0,0,0,0,0,0,0,0,0,0,0,0,0,0,0,0,0,0,0,0,0,40,255,255,165,0,0,0,0,0,0,0,0,0,0,0,0,0,0,0,0
},

{
0,0,0,0,0,0,0,91,255,255,89,0,0,3,35,77,15,0,0,0,0,0,0,0,0,0,0,0,0,0,0,0,0,0,0,0,0,0,0,0,0,0,0,0,100,255,255,100,0,0,7,0,0,0,0,0,0,0,0,0,0,0,0,0
},

{
156,182,207,222,231,235,211,200,255,255,204,192,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0
},

{
255,255,255,255,255,255,255,255,255,255,255,255,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0
},

{
218,230,241,249,253,254,249,245,255,255,219,170,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0
},

{
0,0,0,0,0,0,0,42,255,255,110,0,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0
},

{
0,72,136,191,215,233,205,126,255,255,169,123,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0
},

{
0,255,255,255,255,255,255,255,255,255,255,255,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0
},

{
0,255,255,255,255,255,255,255,255,255,255,250,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0
},

{
0,50,31,13,6,5,21,55,255,255,145,1,0,0,0,0,0,0,0,0,0,0,0,0,0,0,0,0,0,0,0,0,0,32,255,255,205,0,0,0,0,0,193,255,248,16,0,3,137,74,16,0,0,0,0,0,0,0,0,0,0,0,0,0
},

{
0,0,0,0,0,0,0,17,255,255,145,0,0,0,0,0,0,0,0,0,0,0,0,0,0,0,0,0,0,0,0,0,0,128,255,255,154,0,0,0,0,34,254,255,173,0,0,0,0,0,0,0,0,0,0,0,0,0,0,0,0,0,0,0
},

{
0,13,111,183,222,235,223,182,255,255,152,0,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0
},

{
48,230,255,255,255,255,255,255,255,255,235,104,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0
},

{
205,255,255,255,255,255,255,255,255,255,255,255,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0
},

{
247,255,255,147,33,4,6,36,255,255,253,255,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0
},

{
194,255,255,255,255,246,243,255,255,255,109,116,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0
},

{
40,227,255,255,255,255,255,255,255,243,30,0,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0
},

{
0,14,117,192,233,251,250,227,166,44,0,0,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0
},

{
0,0,0,0,0,0,0,0,0,0,0,0,0,0,0,0,0,0,0,0,0,0,0,0,0,0,0,0,0,0,0,0,0,0,0,0,0,0,0,0,68,69,0,0,0,0,0,0,0,0,0,0,0,0,0,0,0,0,0,0,0,0,0,0
},

{
0,0,0,0,0,0,0,0,0,0,0,0,0,0,0,0,0,0,0,0,0,0,0,0,0,0,0,0,0,0,0,0,0,0,0,0,0,0,0,0,0,0,0,0,0,0,0,0,0,0,0,0,0,0,0,0,0,0,0,0,0,0,0,0
},

{
0,0,0,0,0,0,0,0,0,0,0,0,0,0,0,0,0,0,0,0,0,0,0,0,0,0,0,0,0,0,0,0,0,0,0,0,0,0,0,0,0,0,0,0,0,0,0,0,0,0,0,0,0,0,0,0,0,0,0,0,0,0,0,0
},

{
0,0,0,0,0,0,0,0,0,0,0,0,0,0,0,0,0,0,0,0,0,0,0,0,0,0,0,0,0,0,0,0,0,0,0,0,0,0,0,0,0,0,0,0,0,0,0,0,0,0,0,0,0,0,0,0,0,0,0,0,0,0,0,0
},

{
0,0,0,0,0,0,0,0,0,0,0,0,0,0,0,0,0,0,0,0,0,0,0,0,0,0,0,0,0,0,0,0,0,0,0,0,0,0,0,0,0,0,0,0,0,0,0,0,0,0,0,240,240,225,0,0,0,0,0,0,0,0,0,0
},

{
0,43,206,139,48,0,0,0,0,0,0,0,180,240,240,10,0,0,0,0,0,0,0,0,0,0,0,0,0,0,0,0,0,0,0,0,0,0,0,0,0,0,0,0,0,0,0,0,0,0,0,255,255,240,0,0,0,0,0,0,0,0,0,0
},

{
0,113,255,255,100,0,0,0,0,0,0,0,168,255,255,26,0,0,0,0,0,0,0,0,0,0,0,0,0,0,0,0,0,0,0,0,0,0,0,0,0,0,0,0,0,0,0,0,0,0,0,255,255,240,0,0,0,0,0,0,0,0,0,0
},

{
0,183,255,255,37,0,0,0,0,0,0,0,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0
},

{
3,244,255,231,0,0,0,0,0,0,0,0,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0
},

{
49,255,255,179,0,0,0,0,0,0,0,0,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0
},

{
106,255,255,129,0,8,144,205,233,229,218,207,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0
},

{
154,255,255,82,0,5,254,255,255,255,255,255,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0
},

{
194,255,255,47,0,0,238,255,255,253,246,235,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0
},

{
228,255,255,14,0,0,19,10,0,0,0,0,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0
},

{
245,255,252,0,0,0,0,0,0,0,0,4,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0
},

{
251,255,242,11,145,17,0,0,0,0,0,12,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0
},

{
239,255,242,118,255,231,11,0,0,0,0,32,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0
},

{
218,255,253,234,255,170,0,0,0,0,0,63,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0
},

{
182,255,255,255,255,49,0,0,0,0,0,115,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0
},

{
138,255,255,255,203,0,0,0,0,0,0,199,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0
},

{
79,255,255,255,115,0,0,0,0,0,88,255,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0
},

{
18,252,255,255,48,0,0,0,0,77,247,255,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0
},

{
0,191,255,254,7,0,0,14,143,254,255,255,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0
},

{
0,90,160,98,0,0,0,107,255,255,255,215,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0
},

{
0,0,0,0,0,0,0,0,101,249,147,14,0,0,0,0,0,0,0,0,0,0,0,0,0,0,0,0,0,0,0,0,0,0,0,0,0,0,0,0,0,0,0,0,0,0,0,0,0,0,0,255,255,240,0,0,0,0,0,0,0,0,0,0
},

{
0,0,0,0,0,0,0,0,0,17,0,0,0,0,0,0,0,0,0,0,0,0,0,0,0,0,0,0,0,0,0,0,0,0,0,0,0,0,0,0,0,0,0,0,0,0,0,0,0,0,0,0,0,0,0,0,0,0,0,0,0,0,0,0
},

{
0,0,0,0,0,0,0,0,0,0,0,0,0,0,0,0,0,0,0,0,0,0,0,0,0,0,0,0,0,0,0,0,0,0,0,0,0,0,0,0,0,0,0,0,0,0,0,0,0,0,0,0,0,0,0,0,0,0,0,0,0,0,0,0
},

{
0,0,0,0,0,0,0,0,0,0,0,0,0,0,0,0,0,0,0,0,0,0,0,0,0,0,0,0,0,0,0,0,0,0,0,0,0,0,0,0,0,0,0,0,0,0,0,0,0,0,0,0,0,0,0,0,0,0,0,0,0,0,0,0
},

